## drivers/cci/Kconfig
```kconfig
#
# Copyright (C) 2013 Sony Mobile Communications AB.
# Compalcomm drivers
#

menuconfig CCI_DRIVERS
        tristate "Compalcomm drivers for VY5x."
        default y

if CCI_DRIVERS

#[VY5x] ==> CCI KLog, added by Jimmy@CCI
source "drivers/cci/klog/Kconfig"
#[VY5x] <== CCI KLog, added by Jimmy@CCI

source "drivers/cci/cci_stuff/Kconfig"

#[VY5x] S:LE
source "drivers/cci/cci_kernel_info/Kconfig"
#[VY5x] E:LE

#[VY5x] ==> DDR parameter dump, added by Grace@CCI
source "drivers/cci/ddr_param_dump/Kconfig"
#[VY5x] <== DDR parameter dump, added by Grace@CCI
endif
```

## drivers/cci/cci_kernel_info/Kconfig
```kconfig
#
# Copyright (C) 2013 Sony Mobile Communications AB.
#
config CCI_KERNEL_INFO
	tristate "CCI kernel info"
	default y
```

## drivers/cci/ddr_param_dump/Kconfig
```kconfig
#
# Copyright (C) 2012 Sony Mobile Communications AB.
#
config CCI_DDR_PARAM_DUMP
	tristate "CCI DDR PARAM DUMP"
	default y
```
